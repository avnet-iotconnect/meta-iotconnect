## conf/layer.conf
```bitbake
# We have a conf and classes directory, add to BBPATH
BBPATH .= ":${LAYERDIR}"

# We have recipes-* directories, add to BBFILES
BBFILES += "${LAYERDIR}/recipes-*/*/*.bb \
            ${LAYERDIR}/recipes-*/*/*.bbappend"

BBFILE_COLLECTIONS += "meta-iotconnect-sdk"
BBFILE_PATTERN_meta-iotconnect-sdk = "^${LAYERDIR}/"
BBFILE_PRIORITY_meta-iotconnect-sdk = "6"

LAYERDEPENDS_meta-iotconnect-sdk = "core"
LAYERSERIES_COMPAT_meta-iotconnect-sdk = "mickledore"

CORE_IMAGE_EXTRA_INSTALL += " kernel-modules"

IMAGE_INSTALL += " ${CORE_IMAGE_EXTRA_INSTALL}"

IMAGE_INSTALL += " curl"
IMAGE_INSTALL += " packagegroup-core-boot"

IMAGE_LINGUAS = " "
```

## meta-iotconnect-demos/meta-iotconnect-c-demo/conf/layer.conf
```bitbake
# We have a conf and classes directory, add to BBPATH
BBPATH .= ":${LAYERDIR}"

# We have recipes-* directories, add to BBFILES
BBFILES += "${LAYERDIR}/recipes-*/*/*.bb \
            ${LAYERDIR}/recipes-*/*/*.bbappend"

BBFILE_COLLECTIONS += "meta-iotconnect-c-demo"
BBFILE_PATTERN_meta-iotconnect-c-demo = "^${LAYERDIR}/"
BBFILE_PRIORITY_meta-iotconnect-c-demo = "7"

LAYERDEPENDS_myExampleIotconnectLayer = "core"
LAYERSERIES_COMPAT_meta-iotconnect-c-demo = "kirkstone"

# If you are building a "core" image (ie core-image-base) then you must use CORE_IMAGE_EXTRA_INSTALL
# to add the application otherwise comment the line below out

CORE_IMAGE_EXTRA_INSTALL += " iotc-c-demo-dev"


# If you are building a customised non "core" image then you must use IMAGE_INSTALL
#  to add the application otherwise comment the line below out

# IMAGE_INSTALL += " iotc-c-demo-dev"
```

## meta-iotconnect-demos/meta-iotconnect-python-demo/conf/layer.conf
```bitbake
# We have a conf and classes directory, add to BBPATH
BBPATH .= ":${LAYERDIR}"

# We have recipes-* directories, add to BBFILES
BBFILES += "${LAYERDIR}/recipes-*/*/*.bb \
            ${LAYERDIR}/recipes-*/*/*.bbappend"

BBFILE_COLLECTIONS += "meta-iotconnect-python-demo"
BBFILE_PATTERN_meta-iotconnect-python-demo = "^${LAYERDIR}/"
BBFILE_PRIORITY_meta-iotconnect-python-demo = "6"

LAYERDEPENDS_meta-iotconnect-python-demo = "core"
LAYERSERIES_COMPAT_meta-iotconnect-python-demo = "kirkstone"

# If you are building a "core" image (ie core-image-base) then you must use CORE_IMAGE_EXTRA_INSTALL
# to add the application otherwise comment the line below out

CORE_IMAGE_EXTRA_INSTALL += " iotc-python-demo-dev"


# If you are building a customised non "core" image then you must use IMAGE_INSTALL
#  to add the application otherwise comment the line below out

# IMAGE_INSTALL += " iotc-python-demo-dev"
```
